## conf/layer.conf
```bitbake
# We have a conf and classes directory, add to BBPATH
BBPATH .= ":${LAYERDIR}"

# We have recipes-* directories, add to BBFILES
BBFILES += "${LAYERDIR}/recipes-*/*/*.bb \
            ${LAYERDIR}/recipes-*/*/*.bbappend"

BBFILE_COLLECTIONS += "meta-xa-golang"
BBFILE_PATTERN_meta-xa-golang = "^${LAYERDIR}/"
BBFILE_PRIORITY_meta-xa-golang = "8"

LAYERVERSION_meta-xa-golang = "2.4"
```
